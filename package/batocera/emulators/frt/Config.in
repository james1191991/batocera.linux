## package/batocera/emulators/frt/Config.in
```kconfig
config BR2_PACKAGE_FRT
      bool "frt"
      help
            Godot is a full 2D and 3D game engine with editor.

            FRT is a Godot "platform" targeting single board computers.
            In plain English, you can export a Godot game to most of them by using FRT binaries,
            as long as the game has been designed with the limitation of the hardware in mind.

            https://github.com/efornara/frt
```

## package/batocera/fonts/noto-sans-cjk-tc/Config.in
```kconfig
config BR2_PACKAGE_NOTO_SANS_CJK_TC
    bool "noto-sans-cjk-tc"
    help
      Noto Sans CJK TC fonts
```
